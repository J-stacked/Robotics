///////////////////////////////////////////////////////////////////////////////////////////////////////////////////////////////////////////////////////////////////////////////
//////////////////////////////////////////////////   Including Libraries and Declaring Variables    ///////////////////////////////////////////////////////////////////////////
///////////////////////////////////////////////////////////////////////////////////////////////////////////////////////////////////////////////////////////////////////////////
#include "DualVNH5019MotorShield.h"  

unsigned long CurrentTime;
unsigned long PastTime;  //motor stopping
byte byteRead;

int spin = 11;
bool spinner = false;

DualVNH5019MotorShield md;

///////////////////////////////////////////////////////////////////////////////////////////////////////////////////////////////////////////////////////////////////////////////
////////////////////////////////////////////////////////////////////////////////// Setup! /////////////////////////////////////////////////////////////////////////////////////
///////////////////////////////////////////////////////////////////////////////////////////////////////////////////////////////////////////////////////////////////////////////

void setup(){
  Serial.begin(9600);
  md.init();
  CurrentTime=millis();
  PastTime=millis();
  
  pinMode(spin, OUTPUT);  //spinner
  
  delay(50);
  Serial.println("Setup complete!"); 
}

///////////////////////////////////////////////////////////////////////////////////////////////////////////////////////////////////////////////////////////////////////////////
//////////////////////////////////////////////////          Movement and Control Reading            ///////////////////////////////////////////////////////////////////////////
///////////////////////////////////////////////////////////////////////////////////////////////////////////////////////////////////////////////////////////////////////////////

void loop(){
  
  byteRead=Serial.read();
  //Serial.println(byteRead);

  if(byteRead==119){
    Serial.write(12);  //next page
    Serial.println("Motors moving forward");
    md.setM1Speed(350);
    md.setM2Speed(-350);
  }

  if(byteRead==113){
    Serial.write(12);  //next page
    Serial.println("Motors moving back");
    md.setM1Speed(-350);
    md.setM2Speed(350);
  }
  
  if(byteRead==50){
    Serial.write(12); //next page
    Serial.println("Motors turning right");
    md.setM1Speed(250);
    md.setM2Speed(250);
  }
  
  if(byteRead==49){
    Serial.write(12);  //next page
    Serial.println("Motors turning left");
    md.setM1Speed(-250);
    md.setM2Speed(-250);
  }

  if(byteRead == 116){
    Serial.write(12);  //next page
    Serial.println("Spinning!");
    if(spinner == false){
      spinner = true;
    }else{
      spinner = false;
    }
  }
  
  CurrentTime=millis();  //what if bluetooth loses signal?
  if(CurrentTime-500>PastTime){
    Serial.write(12); //next page
    Serial.println("Motors stopped");
    md.setM1Speed(0);
    md.setM2Speed(0); 
    //PastTime=millis();
  }

  if(CurrentTime-25000>PastTime){
    Serial.write(12); //next page
    Serial.println("Spinner slowing");
    spinner = false; //turn off dat spinner
    PastTime=millis();
  }

  if(byteRead!=255){  //hasn't lost signal yet!
    PastTime=millis();
  }

  if(spinner == false){
      spinnerStop();
  }else{
      spinnerTurn();
  }
}

void spinnerTurn(){
  digitalWrite(spin, HIGH);
}

void spinnerStop(){
  digitalWrite(spin, LOW);
}

